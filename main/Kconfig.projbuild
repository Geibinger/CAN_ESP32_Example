## main/Kconfig.projbuild
```kconfig
menu "CAN Example Configuration"

choice CAN_APP_TARGET
    prompt "Application role"
    default CAN_TARGET_SENDER

config CAN_TARGET_SENDER
    bool "sender"

config CAN_TARGET_RECEIVER
    bool "receiver"

endchoice

config CAN_TX_GPIO_NUM
    int "TX GPIO number"
    default 32
    help
        This option selects the GPIO pin used for the TX signal. Connect the
        TX signal to your transceiver.

config CAN_RX_GPIO_NUM
    int "RX GPIO number"
    default 33
    help
        This option selects the GPIO pin used for the RX signal. Connect the
        RX signal to your transceiver.

config CAN_LED_GPIO_NUM
    int "LED GPIO number"
    default 25
    help
        GPIO connected to the demo LED (only used by the receiver)

endmenu
```
